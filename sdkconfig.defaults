## sdkconfig.defaults
```kconfig
## ESP-SR 语音识别配置(与 sdkconfig.esp32-s3-devkitm-1 保持一致)
## 注意:已有的 sdkconfig 优先级更高,调整这里后需要同步改 sdkconfig 或删除它重新生成

# 模型从 flash 的 model 分区读取
CONFIG_MODEL_IN_FLASH=y

# 唤醒词:你好小智(WakeNet9,ESP32-S3 用 wn9_data_p1,约 220KB)

CONFIG_SR_WN_WN9_NIHAOXIAOZHI_TTS=y
# 中文命令词模型:MultiNet7(mn7_cn,约 2.6MB)
CONFIG_SR_MN_CN_MULTINET7_QUANT=y

# 音频常开链路(AFE 47% + WakeNet10 23%)在 160MHz 下跑不动,必须 240MHz
CONFIG_ESP_DEFAULT_CPU_FREQ_MHZ_240=y

CONFIG_FREERTOS_USE_TRACE_FACILITY=y
CONFIG_FREERTOS_USE_STATS_FORMATTING_FUNCTIONS=y
CONFIG_FREERTOS_GENERATE_RUN_TIME_STATS=y
CONFIG_FREERTOS_RUN_TIME_STATS_USING_ESP_TIMER=y
CONFIG_FREERTOS_VTASKLIST_INCLUDE_COREID=y
CONFIG_ESP_TASK_WDT_CHECK_IDLE_TASK_CPU1=y
```
